#include "qcom-msm7x30-huawei.dtsi"

/ {
	model = "Huawei Honor";

	gen-vkeys {
		compatible = "qcom,gen-vkeys";
		label = "synaptics_i2c_rmi4_hw";
		qcom,disp-maxx = <480>;
		qcom,disp-maxy = <854>;
		qcom,panel-maxx = <480>;
		qcom,panel-maxy = <958>;
		qcom,key-codes = <139 172 158 217>;
		qcom,y-offset = <41>;
	};
};

#include "mddi-panel-novatek-truly-type2.dtsi"

&i2c0 {
	synaptics-rmi4@70 {
		synaptics,panel-coords = <480 958>;
		synaptics,display-coords = <480 854>;
	};
};
